## firmware/nuttx/overlay/apps/examples/compukter_bench/Kconfig
```kconfig
# SPDX-License-Identifier: Apache-2.0

config EXAMPLES_COMPUKTER_BENCH
	tristate "Compukter saturated CPU benchmark command"
	default n

if EXAMPLES_COMPUKTER_BENCH

config EXAMPLES_COMPUKTER_BENCH_PROGNAME
	string "Program name"
	default "bench"

config EXAMPLES_COMPUKTER_BENCH_PRIORITY
	int "Task priority"
	default 100

config EXAMPLES_COMPUKTER_BENCH_STACKSIZE
	int "Task stack size"
	default 1024

endif
```

## firmware/nuttx/overlay/apps/examples/compukter_hello/Kconfig
```kconfig
# SPDX-License-Identifier: Apache-2.0

config EXAMPLES_COMPUKTER_HELLO
	tristate "Compukter NuttX acceptance command"
	default n

if EXAMPLES_COMPUKTER_HELLO

config EXAMPLES_COMPUKTER_HELLO_PROGNAME
	string "Program name"
	default "hello"

config EXAMPLES_COMPUKTER_HELLO_PRIORITY
	int "Task priority"
	default 100

config EXAMPLES_COMPUKTER_HELLO_STACKSIZE
	int "Task stack size"
	default 2048

endif
```

## firmware/nuttx/overlay/nuttx/boards/risc-v/compukter/compukter-vm/configs/bench/defconfig
```kconfig
CONFIG_16550_ADDRWIDTH=0
CONFIG_16550_UART=y
CONFIG_16550_UART0=y
CONFIG_16550_UART0_BASE=0x10001000
CONFIG_16550_UART0_CLOCK=3686400
CONFIG_16550_UART0_IRQ=28
CONFIG_16550_UART0_SERIAL_CONSOLE=y
CONFIG_ARCH="risc-v"
CONFIG_ARCH_BOARD="compukter-vm"
CONFIG_ARCH_BOARD_COMPUKTER_VM=y
CONFIG_ARCH_CHIP="compukter"
CONFIG_ARCH_CHIP_COMPUKTER=y
CONFIG_ARCH_INTERRUPTSTACK=1024
CONFIG_ARCH_RISCV=y
CONFIG_BUILTIN=y
CONFIG_DEBUG_FULLOPT=y
CONFIG_DEFAULT_TASK_STACKSIZE=1024
CONFIG_EXAMPLES_COMPUKTER_BENCH=y
CONFIG_EXAMPLES_COMPUKTER_BENCH_PRIORITY=100
CONFIG_EXAMPLES_COMPUKTER_BENCH_PROGNAME="bench"
CONFIG_EXAMPLES_COMPUKTER_BENCH_STACKSIZE=1024
CONFIG_IDLETHREAD_STACKSIZE=1024
CONFIG_INIT_ENTRYPOINT="nsh_main"
CONFIG_LIBC_PERROR_STDOUT=y
CONFIG_LIBC_STRERROR=y
CONFIG_LIBM=y
CONFIG_NFILE_DESCRIPTORS_PER_BLOCK=4
CONFIG_NSH_BUILTIN_APPS=y
CONFIG_NSH_FILEIOSIZE=128
CONFIG_NSH_READLINE=y
CONFIG_RAM_SIZE=1044480
CONFIG_RAM_START=0x1000
CONFIG_RISCV_TOOLCHAIN_CLANG=y
CONFIG_SCHED_WAITPID=y
CONFIG_SERIAL_UART_ARCH_MMIO=y
CONFIG_SYSTEM_NSH=y
CONFIG_USEC_PER_TICK=50000
```

## firmware/nuttx/overlay/nuttx/boards/risc-v/compukter/compukter-vm/configs/nsh/defconfig
```kconfig
CONFIG_16550_ADDRWIDTH=0
CONFIG_16550_UART=y
CONFIG_16550_UART0=y
CONFIG_16550_UART0_BASE=0x10001000
CONFIG_16550_UART0_CLOCK=3686400
CONFIG_16550_UART0_IRQ=28
CONFIG_16550_UART0_SERIAL_CONSOLE=y
CONFIG_ARCH="risc-v"
CONFIG_ARCH_BOARD="compukter-vm"
CONFIG_ARCH_BOARD_COMPUKTER_VM=y
CONFIG_ARCH_CHIP="compukter"
CONFIG_ARCH_CHIP_COMPUKTER=y
CONFIG_ARCH_INTERRUPTSTACK=2048
CONFIG_ARCH_RISCV=y
CONFIG_ARCH_STACKDUMP=y
CONFIG_BUILTIN=y
CONFIG_DEBUG_FULLOPT=y
CONFIG_DEFAULT_TASK_STACKSIZE=2048
CONFIG_IDLETHREAD_STACKSIZE=2048
CONFIG_INIT_ENTRYPOINT="nsh_main"
CONFIG_LIBC_PERROR_STDOUT=y
CONFIG_LIBC_STRERROR=y
CONFIG_LIBM=y
CONFIG_NFILE_DESCRIPTORS_PER_BLOCK=6
CONFIG_NSH_BUILTIN_APPS=y
CONFIG_NSH_FILEIOSIZE=512
CONFIG_NSH_READLINE=y
CONFIG_RAM_SIZE=16773120
CONFIG_RAM_START=0x1000
CONFIG_READLINE_CMD_HISTORY=y
CONFIG_RISCV_TOOLCHAIN_CLANG=y
CONFIG_SCHED_WAITPID=y
CONFIG_SERIAL_UART_ARCH_MMIO=y
CONFIG_STACK_COLORATION=y
CONFIG_SYSTEM_NSH=y
CONFIG_USEC_PER_TICK=50000
```
